## KernelSU-Next/kernel/Kconfig
```kconfig
menu "KernelSU"

config KSU
	tristate "KernelSU function support"
	default y
	help
	  Enable kernel-level root privileges on Android System.
	  Requires CONFIG_KPROBES for kernel hooking support.
	  To compile as a module, choose M here: the
	  module will be called kernelsu.

config KSU_DEBUG
	bool "KernelSU debug mode"
	depends on KSU
	default n
	help
	  Enable KernelSU debug mode.

config KSU_DISABLE_MANAGER
	bool "Disable KernelSU manager integration"
	depends on KSU
	default n
	help
	  Disable manager APK detection and manager-specific handling.
	  Root will be used in place of manager-only functionality.

config KSU_DISABLE_POLICY
	bool "Disable KernelSU policy profiles"
	depends on KSU
	default n
	help
	  Disable per-app root/non-root profile customization.
	  Escalation will always use the default full root profile, and
	  non-root handling will follow the global umount policy only.

config KSU_ALLOWLIST_WORKAROUND
	bool "KernelSU allowlist workaround"
	depends on KSU
	default n
	help
	  Enable workaround for broken allowlist save

# For easier extern ifdef handling
config KSU_MANUAL_HOOK
	bool "KernelSU manual hook mode."
	depends on KSU && KSU != m
	default y if !KPROBES
	default n
	help
	  Enable manual hook support.

config KSU_KPROBES_HOOK
	bool "KernelSU tracepoint+kretprobe hook"
	depends on KSU && !KSU_MANUAL_HOOK
	depends on KRETPROBES && KPROBES && HAVE_SYSCALL_TRACEPOINTS
	default y if KPROBES && KRETPROBES && HAVE_SYSCALL_TRACEPOINTS
	default y if !KSU_MANUAL_HOOK
	help
	  Enable KPROBES, KRETPROBES and TRACEPOINT hook for KernelSU core.
	  This should not be used on kernel below 5.10.

endmenu

menu "KernelSU - SUSFS"

config KSU_SUSFS
	bool "KernelSU addon - SUSFS"
	depends on KSU
	default y
	help
	  Patch and Enable SUSFS to kernel with KernelSU.

config KSU_SUSFS_SUS_PATH
	bool "Enable to hide suspicious path"
	depends on KSU_SUSFS
	default y
	help
	  Allow hiding the user-defined path and all its sub-paths from various system calls.

config KSU_SUSFS_SUS_MOUNT
	bool "Enable to hide suspicious mounts"
	depends on KSU_SUSFS
	default y
	help
	  Allow hiding the user-defined mount paths from /proc/self/[mounts|mountinfo|mountstat].

config KSU_SUSFS_AUTO_ADD_SUS_KSU_DEFAULT_MOUNT
	bool "Auto-add KSU default mounts to sus_mount"
	depends on KSU_SUSFS_SUS_MOUNT
	default y
	help
	  Automatically add KSU's default mounts to sus_mount.

config KSU_SUSFS_AUTO_ADD_SUS_BIND_MOUNT
	bool "Auto-add suspicious bind mounts"
	depends on KSU_SUSFS_SUS_MOUNT
	default y
	help
	  Automatically add binded mounts to sus_mount.

config KSU_SUSFS_SUS_KSTAT
	bool "Enable to spoof suspicious kstat"
	depends on KSU_SUSFS
	default y
	help
	  Allow spoofing the kstat of user-defined file/directory.

config KSU_SUSFS_SUS_OVERLAYFS
	bool "Enable auto spoof for overlayed files"
	depends on KSU_SUSFS
	default n
	help
	  Automatically spoof the kstat and kstatfs for overlayed files/directories.

config KSU_SUSFS_TRY_UMOUNT
	bool "Enable try_umount"
	depends on KSU_SUSFS
	default y
	help
	  Allow using try_umount to umount other user-defined mount paths.

config KSU_SUSFS_AUTO_ADD_TRY_UMOUNT_FOR_BIND_MOUNT
	bool "Auto-add bind mounts to try_umount"
	depends on KSU_SUSFS_TRY_UMOUNT
	default y
	help
	  Automatically add binded mounts to try_umount.

config KSU_SUSFS_SPOOF_UNAME
	bool "Enable to spoof uname"
	depends on KSU_SUSFS
	default y
	help
	  Allow spoofing the string returned by uname syscall.

config KSU_SUSFS_ENABLE_LOG
	bool "Enable logging susfs log to kernel"
	depends on KSU_SUSFS
	default n
	help
	  Allow logging susfs log to kernel.

config KSU_SUSFS_HIDE_KSU_SUSFS_SYMBOLS
	bool "Hide KSU/SUSFS symbols from kallsyms"
	depends on KSU_SUSFS
	default y
	help
	  Automatically hide ksu and susfs symbols from /proc/kallsyms.

config KSU_SUSFS_SPOOF_CMDLINE_OR_BOOTCONFIG
	bool "Enable to spoof /proc/cmdline"
	depends on KSU_SUSFS
	default y
	help
	  Spoof the output of /proc/cmdline with a user-defined file.

config KSU_SUSFS_OPEN_REDIRECT
	bool "Enable open redirect"
	depends on KSU_SUSFS
	default y
	help
	  Allow redirecting a target path to be opened with another user-defined path.

config KSU_SUSFS_SUS_SU
	bool "Enable sus_su (non-kprobe su)"
	depends on KSU_SUSFS
	default n
	help
	  Enable non-kprobe based su via char device.

endmenu
```
